## Linux/buildroot-2022.02.3/package/cyclictest/Config.in
```kconfig
config BR2_PACKAGE_CYCLICTEST
	bool "cyclictest"
	help
	  A simple package that allows testing of latency in the real-time linux kernel

	  https://mirrors.edge.kernel.org/pub/linux/utils/rt-tests/
```

## Linux/buildroot-2022.02.3/package/pidtest/Config.in
```kconfig
config BR2_PACKAGE_PIDTEST
	bool "pidtest"
	help
	  A simple package that allows the quadcopter to perform a PID test on a PID testing jig such as the one at
	  https://invidious.tiekoetter.com/watch?v=wF-CDtk_bKk.

	  https://www.sckz.org
```

## Linux/buildroot-2022.02.3/package/selftest/Config.in
```kconfig
config BR2_PACKAGE_SELFTEST
	bool "selftest"
	help
	  A simple package that allows the quadcopter to check it's hardware.

	  https://www.sckz.org
```
